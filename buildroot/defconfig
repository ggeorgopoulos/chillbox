## buildroot/defconfig
```kconfig
BR2_arm=y
BR2_arm1176jzf_s=y
BR2_ENABLE_LOCALE_PURGE=y
BR2_ENABLE_LOCALE_WHITELIST="C"
# BR2_SOFT_FLOAT is not set
BR2_TOOLCHAIN_BUILDROOT_LARGEFILE=y
BR2_TOOLCHAIN_BUILDROOT_INET_IPV6=y
BR2_TOOLCHAIN_BUILDROOT_INET_RPC=y
BR2_TOOLCHAIN_BUILDROOT_WCHAR=y
BR2_TOOLCHAIN_BUILDROOT_CXX=y
BR2_VFP_FLOAT=y
BR2_TARGET_GENERIC_HOSTNAME="recovery"
BR2_TARGET_GENERIC_ISSUE="Welcome to ChillBox"
BR2_ROOTFS_DEVICE_CREATION_DYNAMIC_DEVTMPFS=y
BR2_TARGET_GENERIC_ROOT_PASSWD="raspberry"
BR2_TARGET_GENERIC_GETTY_PORT="ttyAMA0"
BR2_ROOTFS_POST_BUILD_SCRIPT="package/recovery/cleanup.sh"
BR2_PACKAGE_RECOVERY=y
BR2_PACKAGE_ARORA=y
BR2_PACKAGE_BUSYBOX_SHOW_OTHERS=y
BR2_PACKAGE_MTOOLS=y
BR2_PACKAGE_FBSET=y
BR2_PACKAGE_QT_LICENSE_APPROVED=y
# BR2_PACKAGE_QT_PIXEL_DEPTH_8 is not set
# BR2_PACKAGE_QT_FONT_MICRO is not set
# BR2_PACKAGE_QT_FONT_FIXED is not set
# BR2_PACKAGE_QT_FONT_HELVETICA is not set
BR2_PACKAGE_QT_QTFREETYPE=y
BR2_PACKAGE_QT_GIF=y
BR2_PACKAGE_QT_QTJPEG=y
BR2_PACKAGE_QT_QTPNG=y
BR2_PACKAGE_QT_SYSTEMZLIB=y
BR2_PACKAGE_QT_GFX_VNC=y
BR2_PACKAGE_QT_MOUSE_PC=y
BR2_PACKAGE_QT_KEYBOARD_TTY=y
BR2_PACKAGE_QT_DBUS=y
# BR2_PACKAGE_QT_XML is not set
BR2_PACKAGE_QT_WEBKIT=y
BR2_PACKAGE_QJSON=y
BR2_PACKAGE_DOSFSTOOLS=y
BR2_PACKAGE_DOSFSTOOLS_MKDOSFS=y
BR2_PACKAGE_DOSFSTOOLS_DOSFSCK=y
BR2_PACKAGE_E2FSPROGS=y
# BR2_PACKAGE_E2FSPROGS_BADBLOCKS is not set
# BR2_PACKAGE_E2FSPROGS_CHATTR is not set
# BR2_PACKAGE_E2FSPROGS_DUMPE2FS is not set
# BR2_PACKAGE_E2FSPROGS_E2FREEFRAG is not set
# BR2_PACKAGE_E2FSPROGS_E2UNDO is not set
# BR2_PACKAGE_E2FSPROGS_FILEFRAG is not set
# BR2_PACKAGE_E2FSPROGS_FINDFS is not set
# BR2_PACKAGE_E2FSPROGS_LOGSAVE is not set
# BR2_PACKAGE_E2FSPROGS_LSATTR is not set
# BR2_PACKAGE_E2FSPROGS_MKLOSTFOUND is not set
BR2_PACKAGE_E2FSPROGS_RESIZE2FS=y
# BR2_PACKAGE_E2FSPROGS_TUNE2FS is not set
# BR2_PACKAGE_E2FSPROGS_UUIDGEN is not set
BR2_PACKAGE_RPI_FIRMWARE=y
BR2_PACKAGE_PARTED=y
BR2_PACKAGE_RPI_USERLAND=y
BR2_PACKAGE_NODEJS=y
BR2_PACKAGE_NODEJS_NPM=y
BR2_PACKAGE_NODEJS_MODULES_EXPRESS=y
BR2_PACKAGE_NODEJS_MODULES_ADDITIONAL="ws mdns"
BR2_PACKAGE_NODEJS_MODULES_ADDITIONAL_DEPS="avahi"
BR2_PACKAGE_CURL=y
BR2_PACKAGE_LIBGLIB2=y
BR2_PACKAGE_AVAHI=y
BR2_PACKAGE_AVAHI_DAEMON=y
BR2_PACKAGE_AVAHI_LIBDNSSD_COMPATIBILITY=y
BR2_PACKAGE_UTIL_LINUX_BINARIES=y
BR2_PACKAGE_UTIL_LINUX_PARTX=y
BR2_TARGET_ROOTFS_CPIO=y
BR2_TARGET_ROOTFS_CPIO_LZO=y
# BR2_TARGET_ROOTFS_TAR is not set
BR2_LINUX_KERNEL=y
BR2_LINUX_KERNEL_CUSTOM_GIT=y
BR2_LINUX_KERNEL_CUSTOM_GIT_REPO_URL="git://github.com/raspberrypi/linux.git"
BR2_LINUX_KERNEL_CUSTOM_GIT_VERSION="rpi-3.6.y"
BR2_LINUX_KERNEL_PATCH="$(TOPDIR)/board/raspberrypi/kernel-patches/"
BR2_LINUX_KERNEL_USE_CUSTOM_CONFIG=y
BR2_LINUX_KERNEL_CUSTOM_CONFIG_FILE="kernelconfig-recovery"
BR2_LINUX_KERNEL_ZIMAGE=y
```
